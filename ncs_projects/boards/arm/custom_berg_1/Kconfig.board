## ncs_projects/boards/arm/custom_berg_1/Kconfig.board
```kconfig
# nRF52 DK CUSTOM BERG 1 board configuration

config BOARD_NRF52DK_CUSTOM_BERG_1
	bool "nRF52 DK NRF52832"
	depends on SOC_NRF52832_QFAA
```

## ncs_projects/boards/arm/custom_berg_1/Kconfig.defconfig
```kconfig
# nRF52 DK CUSTOM BERG 1 board configuration

if BOARD_NRF52DK_CUSTOM_BERG_1

config BOARD
	default "nrf52dk_custom_berg_1"

config BT_CTLR
	default BT

endif # BOARD_NRF52DK_CUSTOM_BERG_1
```

## ncs_projects/drivers/icm20948/icm20948/Kconfig
```kconfig
config ICM20948
	bool "ICM20948 sensor"
	depends on I2C
	help
	  Enable driver for the TH02 temperature sensor.
```
